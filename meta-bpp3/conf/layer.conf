## meta-bpp3/conf/layer.conf
```bitbake
# We have a conf and classes directory, add to BBPATH
BBPATH := "${BBPATH}:${LAYERDIR}"

# We have a recipes directory, add to BBFILES
BBFILES := "${BBFILES} ${LAYERDIR}/recipes-*/*/*.bb \
	${LAYERDIR}/recipes-*/*/*.bbappend"

BBFILE_COLLECTIONS += "bpp3"
BBFILE_PATTERN_bpp3 := "^${LAYERDIR}/"
BBFILE_PRIORITY_bpp3 = "6"
```

## meta-eldk/conf/distro/eldk.conf
```bitbake
DISTRO = "eldk"
DISTRO_NAME = "ELDK"
DISTRO_VERSION = "5.2"
SDK_VENDOR = "-eldk"
SDK_VERSION := "${DISTRO_VERSION}"

MAINTAINER = "Wolfgang Denk <wd@denx.de>"

TARGET_VENDOR = ""

LOCALCONF_VERSION = "1"

# Strip the "generic-" from machine name
MACHINE_NO_GENERIC = "${@d.getVar('MACHINE', 1).replace('generic-', '')}"
MACHINE_STRIPPED = "${@d.getVar(['MACHINE', 'MACHINE_NO_GENERIC'][d.getVar('MACHINE', 1).startswith('generic-')], 1)}"

SDK_NAME = "${DISTRO}-${TCLIBC}-${SDK_ARCH}-${TARGET_ARCH}"
SDKPATH = "/opt/${DISTRO}-${DISTRO_VERSION}/${MACHINE_STRIPPED}"

DISTRO_EXTRA_RDEPENDS += "task-core-boot"

TCLIBCAPPEND = ""

QEMU_TARGETS ?= "arm ppc"

# Add ${MACHINE}-gcc type symlinks for the tools
INHERIT += "add_machine_symlinks"

PREMIRRORS ?= "\
bzr://.*/.*   http://autobuilder.yoctoproject.org/sources/ \n \
cvs://.*/.*   http://autobuilder.yoctoproject.org/sources/ \n \
git://.*/.*   http://autobuilder.yoctoproject.org/sources/ \n \
hg://.*/.*    http://autobuilder.yoctoproject.org/sources/ \n \
osc://.*/.*   http://autobuilder.yoctoproject.org/sources/ \n \
p4://.*/.*    http://autobuilder.yoctoproject.org/sources/ \n \
svk://.*/.*   http://autobuilder.yoctoproject.org/sources/ \n \
svn://.*/.*   http://autobuilder.yoctoproject.org/sources/ \n"

MIRRORS =+ "\
ftp://.*/.*      http://autobuilder.yoctoproject.org/sources/ \n \
http://.*/.*     http://autobuilder.yoctoproject.org/sources/ \n \
https://.*/.*    http://autobuilder.yoctoproject.org/sources/ \n"
```

## meta-eldk/conf/layer.conf
```bitbake
# We have a conf and classes directory, add to BBPATH
BBPATH := "${BBPATH}:${LAYERDIR}"

# We have a packages directory, add to BBFILES
BBFILES := "${BBFILES} ${LAYERDIR}/recipes-*/*/*.bb \
            ${LAYERDIR}/recipes-*/*/*.bbappend"

BBFILE_COLLECTIONS += "eldk"
BBFILE_PATTERN_eldk := "^${LAYERDIR}/"
BBFILE_PRIORITY_eldk = "5"
```

## meta-eldk/conf/machine/enbw_cmc.conf
```bitbake
#@TYPE: Machine
#@NAME: EnBW CMC amv5te machine
#@DESCRIPTION: Machine configuration for EnBW CMC board

# use defaults for arm926ejs
require conf/machine/include/tune-arm926ejs.inc

# variable needed for compilation
MACHINE_FEATURES ?= ""

PREFERRED_PROVIDER_virtual/kernel ?= "linux-enbw-cmc"

# works with new kernel from git
PREFERRED_VERSION_linux-enbw-cmc ?= "3.1%"

# the following 3 lines are commented - because not suppoted yet
#PREFERRED_PROVIDER_linux-libc-headers ?= "linux-libc-headers-enbw-cmc"
#PREFERRED_PROVIDER_linux-libc-headers-dev ?= "linux-libc-headers-enbw-cmc-dev"
#OLDEST_KERNEL = "3.1.0"

# generate uImage variant of linux kernel
KERNEL_IMAGETYPE = "uImage"

# generate flattened device tree
KERNEL_DEVICETREE = "${S}/arch/arm/boot/dts/enbw_cmc.dts"


# as minimum ubifs format of rootfs is required to program nand memory
IMAGE_FSTYPES += "ubifs"

# use specific u-boot from git
EXTRA_IMAGEDEPENDS += "u-boot-enbw-cmc"

# custom file system permissions file - needed to allow logging to the fs instead of volatile
FILESYSTEM_PERMS_TABLES="${COREBASE}/meta-eldk/recipes-enbw_cmc/files/fs-perms.txt"

# config of u-boot to be used
UBOOT_MACHINE = "enbw_cmc_config"
UBOOT_ENTRYPOINT = "0x80008000"
UBOOT_LOADADDRESS = "0x80008000"

# parameters for sysvinit inittab
SERIAL_CONSOLE = "115200 ttyS2"
SYSVINIT_ENABLED_GETTYS = 0
USE_VT = 0
```

## meta-eldk/conf/machine/generic-armv5te.conf
```bitbake
#@TYPE: Machine
#@NAME: Generic armv5te machine
#@DESCRIPTION: Machine configuration for armv5te based boards

require conf/machine/include/tune-arm926ejs.inc

# variable needed for compilation
MACHINE_FEATURES ?= ""

PREFERRED_PROVIDER_virtual/kernel ?= "linux"
PREFERRED_PROVIDER_virtual/xserver ?= "xserver-xf86-lite"

KERNEL_IMAGETYPE = "uImage"

SERIAL_CONSOLE = "115200 console"
```

## meta-eldk/conf/machine/generic-armv7a.conf
```bitbake
#@TYPE: Machine
#@NAME: Generic armv7a machine
#@DESCRIPTION: Machine configuration for armv7a based boards

DEFAULTTUNE = "armv7a-neon"

require conf/machine/include/arm/arch-armv7a.inc

# variable needed for compilation
MACHINE_FEATURES ?= ""

PREFERRED_PROVIDER_virtual/kernel ?= "linux"
PREFERRED_PROVIDER_virtual/xserver ?= "xserver-xf86-lite"

KERNEL_IMAGETYPE = "uImage"

SERIAL_CONSOLE = "115200 console"
```

## meta-eldk/recipes-kernel/linux/linux-3.3.3/generic-powerpc-softfloat/defconfig
```kconfig
CONFIG_EXPERIMENTAL=y
CONFIG_SYSVIPC=y
CONFIG_SPARSE_IRQ=y
CONFIG_IKCONFIG=y
CONFIG_IKCONFIG_PROC=y
CONFIG_LOG_BUF_SHIFT=14
# CONFIG_UTS_NS is not set
# CONFIG_IPC_NS is not set
# CONFIG_USER_NS is not set
# CONFIG_PID_NS is not set
# CONFIG_NET_NS is not set
CONFIG_BLK_DEV_INITRD=y
CONFIG_MODULES=y
CONFIG_MODULE_UNLOAD=y
# CONFIG_BLK_DEV_BSG is not set
CONFIG_PARTITION_ADVANCED=y
# CONFIG_PPC_CHRP is not set
# CONFIG_PPC_PMAC is not set
CONFIG_PPC_83xx=y
CONFIG_MPC830x_RDB=y
# CONFIG_PPC_OF_BOOT_TRAMPOLINE is not set
CONFIG_NO_HZ=y
CONFIG_HIGH_RES_TIMERS=y
# CONFIG_CORE_DUMP_DEFAULT_ELF_HEADERS is not set
# CONFIG_SUSPEND is not set
CONFIG_PCI=y
CONFIG_PCIEPORTBUS=y
# CONFIG_PCIEAER is not set
CONFIG_PCI_MSI=y
CONFIG_ADVANCED_OPTIONS=y
CONFIG_NET=y
CONFIG_PACKET=y
CONFIG_UNIX=y
CONFIG_INET=y
CONFIG_IP_MULTICAST=y
CONFIG_IP_PNP=y
CONFIG_IP_PNP_DHCP=y
CONFIG_IP_PNP_BOOTP=y
CONFIG_SYN_COOKIES=y
# CONFIG_INET_LRO is not set
# CONFIG_IPV6 is not set
# CONFIG_WIRELESS is not set
CONFIG_UEVENT_HELPER_PATH="/sbin/hotplug"
CONFIG_MTD=y
CONFIG_MTD_OF_PARTS=y
CONFIG_MTD_CHAR=y
CONFIG_MTD_BLOCK=y
CONFIG_MTD_CFI=y
CONFIG_MTD_CFI_AMDSTD=y
CONFIG_MTD_PHYSMAP_OF=y
CONFIG_PROC_DEVICETREE=y
CONFIG_BLK_DEV_LOOP=y
CONFIG_BLK_DEV_RAM=y
CONFIG_BLK_DEV_RAM_SIZE=32768
CONFIG_EEPROM_AT24=y
CONFIG_NETDEVICES=y
CONFIG_GIANFAR=y
CONFIG_MARVELL_PHY=y
CONFIG_DAVICOM_PHY=y
CONFIG_QSEMI_PHY=y
CONFIG_LXT_PHY=y
CONFIG_CICADA_PHY=y
CONFIG_VITESSE_PHY=y
CONFIG_SMSC_PHY=y
CONFIG_BROADCOM_PHY=y
CONFIG_ICPLUS_PHY=y
CONFIG_REALTEK_PHY=y
CONFIG_NATIONAL_PHY=y
CONFIG_STE10XP=y
CONFIG_LSI_ET1011C_PHY=y
CONFIG_MICREL_PHY=y
CONFIG_FIXED_PHY=y
# CONFIG_WLAN is not set
# CONFIG_INPUT_KEYBOARD is not set
# CONFIG_INPUT_MOUSE is not set
# CONFIG_SERIO is not set
CONFIG_SERIAL_8250=y
CONFIG_SERIAL_8250_CONSOLE=y
CONFIG_HW_RANDOM=y
CONFIG_I2C=y
CONFIG_I2C_CHARDEV=y
CONFIG_I2C_MPC=y
CONFIG_SPI=y
CONFIG_SPI_BITBANG=y
CONFIG_GPIOLIB=y
CONFIG_GPIO_SYSFS=y
CONFIG_SENSORS_LM75=y
# CONFIG_HID_SUPPORT is not set
CONFIG_USB_GADGET=y
CONFIG_USB_FSL_USB2=m
CONFIG_USB_ZERO=m
CONFIG_USB_ETH=m
CONFIG_USB_GADGETFS=m
CONFIG_USB_FILE_STORAGE=m
CONFIG_USB_MASS_STORAGE=m
CONFIG_NEW_LEDS=y
CONFIG_LEDS_CLASS=y
CONFIG_LEDS_TRIGGERS=y
CONFIG_RTC_CLASS=y
CONFIG_RTC_INTF_DEV_UIE_EMUL=y
CONFIG_RTC_DRV_DS1307=y
CONFIG_DMADEVICES=y
CONFIG_EXT2_FS=y
CONFIG_EXT3_FS=y
# CONFIG_EXT3_DEFAULTS_TO_ORDERED is not set
CONFIG_PROC_KCORE=y
CONFIG_TMPFS=y
CONFIG_JFFS2_FS=y
CONFIG_NFS_FS=y
CONFIG_NFS_V3=y
CONFIG_NFS_V4=y
CONFIG_ROOT_NFS=y
CONFIG_PRINTK_TIME=y
CONFIG_DEBUG_FS=y
CONFIG_SYSCTL_SYSCALL_CHECK=y
CONFIG_CRYPTO_CBC=y
CONFIG_CRYPTO_ECB=y
CONFIG_CRYPTO_MD5=y
CONFIG_CRYPTO_AES=y
CONFIG_CRYPTO_ARC4=y
CONFIG_CRYPTO_DES=y
# CONFIG_CRYPTO_ANSI_CPRNG is not set
```
